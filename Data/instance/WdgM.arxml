AUTOSAR XML (schema 00046)
package /AutosarConfigurator
  module config WdgM: implementation-config-variant=VARIANT-POST-BUILD, module-description=WdgM
    WdgMConfigSet
      WdgMMode: WdgMExpiredSupervisionCycleTol=0, WdgMModeId=0, WdgMSupervisionCycle=0
    WdgMGeneral: WdgMDemStoppedSupervisionReport=False, WdgMDevErrorDetect=False, WdgMImmediateReset=False, WdgMOffModeEnabled=False, WdgMVersionInfoApi=False
      WdgMSupervisedEntity: WdgMSupervisedEntityId=0
        3 x WdgMCheckpoint, all with WdgMCheckpointId=0:
          WdgMCheckpoint
          WdgMCheckpoint_000
          WdgMCheckpoint_001
        WdgMInternalTransition
