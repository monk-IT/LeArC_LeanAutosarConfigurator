AUTOSAR XML (schema 00046)
package /AutosarConfigurator
  module config WdgIf: implementation-config-variant=VARIANT-POST-BUILD, module-description=WdgIf
