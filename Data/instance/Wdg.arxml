AUTOSAR XML (schema 00046)
package /AutosarConfigurator
  module config Wdg: implementation-config-variant=VARIANT-POST-BUILD, module-description=Wdg
